## conf/distro/test-distro.conf
```bitbake
# MAINTAINER = "Alsikely <alsikely773@gmail.com>"
require conf/distro/poky.conf
DISTRO = "test-distro"
DISTRO_VERSION = "1.0"
DISTRO_NAME = "First distribution created by me version ${DISTRO_VERSION}"
DISTRO_FEATURES:remove = "pcmcia pcia ext2 nfc 3g " 
INIT_MANAGER = "systemd"
```

## conf/layer.conf
```bitbake
# We have a conf and classes directory, add to BBPATH
BBPATH .= ":${LAYERDIR}"

# We have recipes-* directories, add to BBFILES
BBFILES += "${LAYERDIR}/recipes-*/*/*.bb \
            ${LAYERDIR}/recipes-*/*/*.bbappend"

BBFILE_COLLECTIONS += "meta-test1"
BBFILE_PATTERN_meta-test1 = "^${LAYERDIR}/"
BBFILE_PRIORITY_meta-test1 = "7"

LAYERDEPENDS_meta-test1 = "core"
LAYERSERIES_COMPAT_meta-test1 = "kirkstone"
```

## conf/machine/test-machine.conf
```bitbake
MACHINEOVERRIDES = "raspberrypi4:${MACHINE}"

require conf/machine/raspberrypi4.conf

ENABLE_UART = "1"
# To disable rpi boot logo,
DISABLE_RPI_BOOT_LOGO = "1"
# # enable I2C
# ENABLE_I2C = "1"
# KERNEL_MODULE_AUTOLOAD:rpi += "i2c-dev i2c-bcm2708"
# #SPI
# ENABLE_SPI_BUS = "1"
#SPLASH
DISABLE_SPLASH = "1"
#U-boot
PRI_USE_U_BOOT = "1"

MACHINE_FEATURES += "wifi"
```
